## boards/shields/card/Kconfig.defconfig
```kconfig
if SHIELD_CARD

config ZMK_KEYBOARD_NAME
    default "guitar"
endif
CONFIG_ZMK_STUDIO=y
CONFIG_ZMK_KSCAN_DIRECT_POLLING=y
```

## boards/shields/guitar/Kconfig.defconfig
```kconfig
if SHIELD_GUITAR

config ZMK_KEYBOARD_NAME
    default "guitar"
endif
CONFIG_ZMK_STUDIO=y
CONFIG_ZMK_KSCAN_DIRECT_POLLING=y
```
