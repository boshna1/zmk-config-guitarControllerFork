#include <physical_layouts.dtsi>

/ {
    physical_layout0: physical_layout_0 {
        compatible = "zmk,physical-layout";
        display-name = "guitar";

        kscan = <&kscan0>;
        transform = <&default_transform>;

        keys = <
            &key_physical_attrs 100 100 0   0 0 0 0

        >;
    };
};
